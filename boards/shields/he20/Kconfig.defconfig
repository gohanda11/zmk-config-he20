## boards/shields/he20/Kconfig.defconfig
```kconfig
if SHIELD_HE20

config ZMK_KEYBOARD_NAME
    default "HE20"

config INPUT
    default y

config ZMK_POINTING
    default y

endif
```

## config/west.yml
```yaml
manifest:
  remotes:
    - name: zmkfirmware
      url-base: https://github.com/zmkfirmware
    - name: gohanda11
      url-base: https://github.com/gohanda11
    - name: badjeff
      url-base: https://github.com/badjeff
  projects:
    - name: zmk
      remote: zmkfirmware
      revision: main
      import: app/west.yml
    - name: zmk-feature-hall-effect
      remote: gohanda11
      revision: main
    - name: zmk-pmw3610-driver
      remote: badjeff
      revision: main
  self:
    path: config
```
